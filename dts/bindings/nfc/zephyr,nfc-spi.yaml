## dts/bindings/nfc/zephyr,nfc-spi.yaml
```yaml
# Copyright (c) 2019, STMicroelectronics
#
# SPDX-License-Identifier: Apache-2.0


title: NFC module based on Zephyr's NFC SPI driver

description: >
    This binding gives the base representation of a NFC module which use
    Zephyr's SPI driver (e.g. st25r3916).

compatible: "zephyr,nfc-spi"

include: spi-device.yaml

properties:
    irq-gpios:
      type: compound
      required: true

    cs-gpios:
      type: phandle-array
      required: false
```
